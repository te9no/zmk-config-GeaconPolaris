/ {
    enc: module-encoder { compatible = "polaris,deferred-ec11", "alps,ec11"; zephyr,deferred-init; };
    joy_enc: joystick-encoder { compatible = "polaris,deferred-ec11", "alps,ec11"; zephyr,deferred-init; };
};
#define left_encoder enc
#include "../../boards/shields/GeaconPolaris/modules/encoder.dtsi"
#undef left_encoder
#define left_encoder joy_enc
#define scroll_runtime_input_processor_l joystick_scroll
#include "../../boards/shields/GeaconPolaris/modules/stick.dtsi"
#undef scroll_runtime_input_processor_l
#undef left_encoder
/* Preserve three encoder edges per JOY trigger with the common 10 triggers/revolution. */
&joy_enc { steps = <30>; };
&sensors { triggers-per-rotation = <10>; };
&joystick_scroll { processor-label = "JoyScr"; };
&anin0 { zephyr,deferred-init; };

#define spi0 spi2
#include "../../boards/shields/GeaconPolaris/modules/trackball_left.dtsi"
#undef spi0
&spi2 { zephyr,deferred-init; };
&trackball2 { zephyr,deferred-init; };
#define scroll_runtime_input_processor_l touchpad_scroll
#include "../../boards/shields/GeaconPolaris/modules/cirque_left.dtsi"
#undef scroll_runtime_input_processor_l
&touchpad_scroll { processor-label = "TpdScr"; };
&i2c0 { zephyr,deferred-init; };
&glidepoint_L { zephyr,deferred-init; };

#include "../../boards/shields/GeaconPolaris/modules/lpps.dtsi"
&lpps_spi { zephyr,deferred-init; };
&adc_ads1220 { zephyr,deferred-init; };
&lpps_axis { zephyr,deferred-init; };

#include "../../boards/shields/GeaconPolaris/zeroshift_dial.dtsi"
/ { split_inputs { remote_lpps: lpps@5 { compatible = "zmk,input-split"; reg = <5>; }; }; };
/ { remote_lpps_listener { compatible = "zmk,input-listener"; device = <&remote_lpps>; }; };

/ {
    dial_listener: optical-dial-listener {
        compatible = "zmk,input-listener";
        device = <&module_dial>;
        input-processors = <&dial_scroll>;
    };
};

/ {
    remote_dial_listener {
        compatible = "zmk,input-listener";
        device = <&remote_dial>;
    };
};

/ {
    zephyr,user {
        iqs-default = <&left_iqs_default>;
        iqs-sleep = <&left_iqs_sleep>;
    };

    left_iqs_listener: left-iqs-listener {
        compatible = "zmk,input-listener";
        device = <&left_iqs>;
        POLARIS_IQS_PROCESSORS
    };
};

&pinctrl {
    left_iqs_default: left-iqs-default {
        group1 {
            psels = <IQS_I2C0_SDA>, <IQS_I2C0_SCL>;
            bias-pull-up;
        };
    };
    left_iqs_sleep: left-iqs-sleep {
        group1 {
            psels = <IQS_I2C0_SDA>, <IQS_I2C0_SCL>;
            low-power-enable;
        };
    };
};

&i2c0 {
    left_iqs: iqs9151@56 {
        compatible = "azoteq,iqs9151";
        reg = <0x56>;
        irq-gpios = IQS_IRQ_GPIOS;
        zephyr,deferred-init;
    };
};
