/ {
    esb_split {
        compatible = "zmk,esb-split";
        /* Polaris trial pair only; address separation is NOT authentication. */
        base-addr-0 = <0x50 0x4f 0x4c 0x41>;
        base-addr-1 = <0x52 0x49 0x53 0x27>;
        addr-prefix = <0x91 0x26 0x53 0xa4 0x75 0xc6 0x37 0xe8>;
    };
    keymap {
        bt_layer {
            label = "USB";
            bindings = <
                &trans &trans &trans &trans &trans &trans &trans &trans &trans &trans &trans &trans
                &trans &trans &trans &trans &trans &trans &trans &trans &trans &trans &trans &trans
                &trans &trans &trans &trans &trans &trans &trans &trans &trans &trans &trans
                &trans &trans &trans &trans &trans &trans &trans &trans &trans &trans &trans
                &kp LEFT &kp UP &kp SPACE &kp DOWN &kp RIGHT &trans &trans &trans
                &trans &trans
            >;
        };
    };
};
