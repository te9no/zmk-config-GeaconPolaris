## Kconfig
```kconfig
config ZMK_BEHAVIOR_ADAFRUIT_BLE_OTA
    bool "Adafruit nRF52 BLE OTA behavior"
    default y
    depends on DT_HAS_ZMK_BEHAVIOR_ADAFRUIT_BLE_OTA_ENABLED
    help
      Enables a key behavior that reboots an Adafruit nRF52 bootloader into
      Nordic Secure DFU mode over Bluetooth.

if ZMK_BEHAVIOR_ADAFRUIT_BLE_OTA

config ZMK_ADAFRUIT_BLE_OTA_MAGIC
    hex "Adafruit nRF52 BLE OTA GPREGRET value"
    default 0xa8
    help
      Magic value consumed by the Adafruit nRF52 bootloader to enter BLE OTA
      mode. Do not change this unless the installed bootloader uses a custom
      value.

endif
```

## boards/shields/GeaconPolaris/Kconfig.shield
```kconfig
config SHIELD_Polaris_R_Base
    def_bool $(shields_list_contains,Polaris_R_Base)

config SHIELD_Polaris_L_Base
    def_bool $(shields_list_contains,Polaris_L_Base)

config SHIELD_Polaris_L_ESB
    def_bool $(shields_list_contains,Polaris_L_ESB)

config SHIELD_Polaris_R_ESB
    def_bool $(shields_list_contains,Polaris_R_ESB)
```

## config/west.yml
```yaml
manifest:
  remotes:
    - name: zmkfirmware
      url-base: https://github.com/zmkfirmware
    - name: te9no
      url-base: https://github.com/te9no
    - name: cormoran
      url-base: https://github.com/cormoran
    - name: ShiniNet
      url-base: https://github.com/ShiniNet
  projects:
    # ESB-only experiment. Pin the maintained fork and NCS compatibility dependencies.
    - name: zmk-feature-split-esb
      url: https://github.com/te9no/zmk-feature-split-esb
      revision: 656477caa56d8909ac78e024cbd943caa6aaa7d7
      clone-depth: 1
    - name: sdk-nrf
      url: https://github.com/badjeff/sdk-nrf
      revision: 9b3d2623fdcd9c0fd0284f860beea924568c9826
      path: nrf
      clone-depth: 1
    - name: nrfxlib
      url: https://github.com/nrfconnect/sdk-nrfxlib
      revision: dfadf17305d8f000eda9aa74a5b9ff1c5647a23e
      path: nrfxlib
      clone-depth: 1
    - name: zmk
      remote: cormoran
      revision: e5c9b6915b56801193e359dd9bad4a167ce0d1b8
      import: app/west.yml

# ZMK RGB LED Widget
    - name: zmk-rgbled-widget
      url: https://github.com/caksoylar/zmk-rgbled-widget
      revision: e6b467792a1dabef8cfa5c9fd26bfefc9c16662b
      path: modules/zmk-rgbled-widget

# ZMK Layout Shift
    - name: zmk-layout-shift
      revision: 4d71f7cb743256ac619873dd44f510e9e9562739
      url: https://github.com/kot149/zmk-layout-shift
      path: modules/zmk-layout-shift

# Custom input processors
    - name: zmk-input-processor-keybind
      revision: 10ad463f2e3c7a7dfb4b7cffd6bddd0e9e8b5bae
      url: https://github.com/te9no/zmk-input-processor-keybind
      path: modules/zmk-input-processor-keybind

# DYA Studio Runtime Processors
    - name: zmk-module-runtime-input-processor
      revision: 72387b5212264d26d704dbc43c765f6485470a77
      url: https://github.com/te9no/zmk-module-runtime-input-processor
      path: modules/zmk-module-runtime-input-processor
    - name: zmk-behavior-runtime-sensor-rotate
      revision: 8b1125ed676c1f5e14145d217984f33d0ebdcef4
      url: https://github.com/cormoran/zmk-behavior-runtime-sensor-rotate
      path: modules/zmk-behavior-runtime-sensor-rotate
    - name: zmk-module-ble-management
      revision: 57738cc4fc6ba80e82a7ac57741a0339cb186cd4
      url: https://github.com/cormoran/zmk-module-ble-management
      path: modules/zmk-module-ble-management
    - name: zmk-module-settings-rpc
      revision: 083a299dd8d31c275809c5a249b12486be24a7d2
      url: https://github.com/te9no/zmk-module-settings-rpc
      path: modules/zmk-module-settings-rpc
    - name: zmk-feature-runtime-combo
      remote: cormoran
      revision: d9490e7b5d41c516221d131241009e81740efcee
      path: modules/zmk-feature-runtime-combo
      import:
        name-blocklist:
          - zmk-feature-custom-settings
    - name: zmk-feature-runtime-macro
      remote: cormoran
      revision: 38530962eb7061b60efcb98e84585cfb1f0cb6de
      path: modules/zmk-feature-runtime-macro
      import:
        name-blocklist:
          - zmk-feature-custom-settings
    - name: zmk-feature-custom-settings
      remote: cormoran
      revision: c6a7fef3a3be3d3ace5de9a4b0628c6418cd1f3f
      path: zmk-feature-custom-settings
    - name: zmk-feature-device-info
      remote: cormoran
      revision: 8cedd2dd9f04e19ea5a17b94914dd47a09d8db11
      path: modules/zmk-feature-device-info
    - name: zmk-feature-watchdog
      remote: cormoran
      revision: 84ad14c6c3645dc40b23f45d08ab45418655f912
      path: modules/zmk-feature-watchdog
    - name: zmk-feature-kscan-diagnostics
      remote: cormoran
      revision: 1432f7fe0cfe903cd7d3c9931ae6bd6f2e1f328e
      path: modules/zmk-feature-kscan-diagnostics
    - name: zmk-module-devtool
      remote: cormoran
      revision: 9938a2c73c06d6e65ba2c0b68c9aa044a467eafc
      path: modules/zmk-module-devtool
    - name: zmk-driver-pmw3610-with-custom-studio-rpc
      remote: cormoran
      revision: 5c34ea0eec246a1c986111417cd779b53144629a
      path: modules/zmk-driver-pmw3610-with-custom-studio-rpc
    - name: zmk-driver-spi-three-wire
      remote: te9no
      revision: 4362133dbfbf66788b66b0a3e3c410b9232c06cb
      path: modules/zmk-driver-spi-three-wire
    - name: zmk-nice-oled
      remote: te9no
      revision: c511d7f64ba0f186051943d027333d247ad8e206
      path: modules/zmk-nice-oled

# Trackpad
# Zephyr 4.1 provides the cirque,pinnacle input driver used by TPD snippets.
    - name: zmk-driver-iqs9151-upstream
      url: https://github.com/ShiniNet/zmk-driver-iqs9151
      revision: 08a6fd19c5aa5ae7f11daf371b5a391cd8596783
      path: modules/zmk-driver-iqs9151-upstream

# Analog input
    - name: ads1220-zephyr-module
      revision: a6f156fa605c9fac93b7a81889134c674dcc8e2c
      url: https://github.com/te9no/ads1220-zephyr-module
      path: modules/ads1220-zephyr-module

    - name: zmk-analog-input-driver
      url: https://github.com/badjeff/zmk-analog-input-driver
      revision: 2684f22ee7e2168d4393f7e63676912210a796fc
      path: modules/zmk-analog-input-driver
    - name: zmk-module-analoginput-rpc
      revision: e065461e907fa924c0029e1d4c94cec1d9093e17
      url: https://github.com/te9no/zmk-module-analoginput-rpc
      path: modules/zmk-module-analoginput-rpc

# ZMK fix for Analog input driver
    - name: zmk-module-battery-nrf-vddh-oversampling
      revision: 59fc126f859d4e7700186c9906e4645379763c34
      url: https://github.com/te9no/zmk-module-battery-nrf-vddh-oversampling
      path: modules/zmk-module-battery-nrf-vddh-oversampling
    - name: zmk-feature-cdc-acm-bootloader-trigger
      revision: 1850754d269aab9ba73e4639371bfe59a4130e65
      url: https://github.com/te9no/zmk-feature-cdc-acm-bootloader-trigger
      path: modules/zmk-feature-cdc-acm-bootloader-trigger
  self:
    path: config
```

## dts/bindings/behaviors/zmk,behavior-adafruit-ble-ota.yaml
```yaml
description: Reboot an Adafruit nRF52 bootloader into BLE OTA mode

compatible: "zmk,behavior-adafruit-ble-ota"

include: zero_param.yaml
```
