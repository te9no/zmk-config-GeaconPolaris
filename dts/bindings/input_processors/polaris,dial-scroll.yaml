## dts/bindings/input_processors/polaris,dial-scroll.yaml
```yaml
description: Convert Polaris optical dial counts to vertical wheel steps
compatible: "polaris,dial-scroll"
include: ip_zero_param.yaml
```

## dts/bindings/sensor/polaris,deferred-ec11.yaml
```yaml
description: Polaris ec11 initialized from the saved module selection
compatible: "polaris,deferred-ec11"
include:
  - name: alps,ec11.yaml
  - name: base.yaml
    property-allowlist:
      - zephyr,deferred-init
```
